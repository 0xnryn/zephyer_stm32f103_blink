## build/Kconfig/arch/Kconfig
```kconfig
# Load Zephyr Arch Kconfig descriptions.
osource "/home/sudha/zephyer_rtos/zephyr/arch/rx/Kconfig"
osource "/home/sudha/zephyer_rtos/zephyr/arch/x86/Kconfig"
osource "/home/sudha/zephyer_rtos/zephyr/arch/xtensa/Kconfig"
osource "/home/sudha/zephyer_rtos/zephyr/arch/sparc/Kconfig"
osource "/home/sudha/zephyer_rtos/zephyr/arch/riscv/Kconfig"
osource "/home/sudha/zephyer_rtos/zephyr/arch/posix/Kconfig"
osource "/home/sudha/zephyer_rtos/zephyr/arch/mips/Kconfig"
osource "/home/sudha/zephyer_rtos/zephyr/arch/arm64/Kconfig"
osource "/home/sudha/zephyer_rtos/zephyr/arch/arm/Kconfig"
osource "/home/sudha/zephyer_rtos/zephyr/arch/arc/Kconfig"
```

## build/Kconfig/boards/Kconfig
```kconfig
# Load Zephyr board Kconfig descriptions.
osource "/home/sudha/zephyer_rtos/zephyr/boards/others/stm32_min_dev/Kconfig"
config BOARD_REVISION_BLUE
	def_bool y
```

## build/Kconfig/boards/Kconfig.defconfig.tmp
```kconfig
# Load Zephyr board defconfig descriptions.
osource "/home/sudha/zephyer_rtos/zephyr/boards/others/stm32_min_dev/Kconfig.defconfig"
```

## build/Kconfig/boards/Kconfig.stm32_min_dev
```kconfig
# Load board Kconfig descriptions.
osource "/home/sudha/zephyer_rtos/zephyr/boards/others/stm32_min_dev/Kconfig.stm32_min_dev"
```

## build/Kconfig/boards/Kconfig.sysbuild
```kconfig
# Load Sysbuild board Kconfig descriptions.
osource "/home/sudha/zephyer_rtos/zephyr/boards/others/stm32_min_dev/Kconfig.sysbuild"
```
