#include <zephyr/kernel.h>
#include <zephyr/device.h>
#include <zephyr/devicetree.h>
#include <zephyr/drivers/sensor.h>
#include <zephyr/drivers/display.h>
#include <zephyr/drivers/gpio.h>
#include <sensor/hx711/hx711.h>
#include <stdio.h>
#include <string.h>

#define SCREEN_WIDTH 128
#define SCREEN_HEIGHT 64

/* --- Advanced Optimization Math --- */
static uint8_t frame_buffer[1024];
static volatile int32_t latest_raw = 0;
static volatile float filtered_raw = 0.0f;

/* Hardcoded from your actual load cell readings! */
static float tare_offset = 8281000.0f; 
static float scale_factor = 200.0f;    

/* --- Hardware Handles --- */
const struct device *hx = DEVICE_DT_GET(DT_NODELABEL(hx711));
const struct device *disp = DEVICE_DT_GET(DT_NODELABEL(ssd1306));
static const struct gpio_dt_spec btn = GPIO_DT_SPEC_GET(DT_ALIAS(tare_btn), gpios);

/* Complete ASCII Font (Space to 'Z') so letters actually render! */
static const uint8_t font_5x7[59][5] = {
    {0x00,0x00,0x00,0x00,0x00}, {0x00,0x00,0x5f,0x00,0x00}, {0x00,0x07,0x00,0x07,0x00}, {0x14,0x7f,0x14,0x7f,0x14}, // Space, !, ", #
    {0x24,0x2a,0x7f,0x2a,0x12}, {0x23,0x13,0x08,0x64,0x62}, {0x36,0x49,0x55,0x22,0x50}, {0x00,0x05,0x03,0x00,0x00}, // $, %, &, '
    {0x00,0x1c,0x22,0x41,0x00}, {0x00,0x41,0x22,0x1c,0x00}, {0x14,0x08,0x3e,0x08,0x14}, {0x08,0x08,0x3e,0x08,0x08}, // (, ), *, +
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    {0x63,0x14,0x08,0x14,0x63}, {0x07,0x08,0x70,0x08,0x07}, {0x61,0x51,0x49,0x45,0x43}  // X, Y, Z
};

static void draw_text(int x, int y, const char *s) {
    while (*s) {
        int idx = 0;
        if (*s >= 32 && *s <= 90) idx = *s - 32; // Directly maps ASCII to our array
        
        for (int i = 0; i < 5; i++) {
            uint8_t col = font_5x7[idx][i];
            for (int j = 0; j < 7; j++) {
                if (col & (1 << j)) frame_buffer[((y + j) / 8) * SCREEN_WIDTH + (x + i)] |= (1 << ((y + j) % 8));
            }
        }
        x += 6; s++;
    }
}

/* --- High Frequency 80Hz Sensor Thread --- */
void sensor_thread(void *p1, void *p2, void *p3) {
    struct sensor_value rate = { .val1 = HX711_RATE_80HZ };
    sensor_attr_set(hx, HX711_SENSOR_CHAN_WEIGHT, SENSOR_ATTR_SAMPLING_FREQUENCY, &rate);
    
    struct sensor_value val;
    float alpha = 0.15f; // EMA filter strength (Lower = smoother but slower to react)

    while (1) {
        // Blocks exactly until the HX711 80Hz DOUT pulse fires
        if (sensor_sample_fetch(hx) == 0) {
            sensor_channel_get(hx, HX711_SENSOR_CHAN_WEIGHT, &val);
            latest_raw = val.val1;
            
            // Apply Exponential Moving Average (EMA) to kill the noise
            if (filtered_raw == 0.0f) filtered_raw = (float)latest_raw; // Initialize
            filtered_raw = (alpha * (float)latest_raw) + ((1.0f - alpha) * filtered_raw);
        }
    }
}
// Run cooperatively at high priority to never miss an 80Hz tick
K_THREAD_DEFINE(s_tid, 1024, sensor_thread, NULL, NULL, NULL, K_PRIO_COOP(1), 0, 0);

/* --- Display Engine --- */
int main(void) {
    gpio_pin_configure_dt(&btn, GPIO_INPUT);
    struct display_buffer_descriptor desc = { .buf_size = 1024, .width = 128, .height = 64, .pitch = 128 };
    char buf[32];

    while (1) {
        memset(frame_buffer, 0, 1024);

        /* 1. Calculate the real weight using the smoothed data */
        float weight = (filtered_raw - tare_offset) / scale_factor;

        /* 2. Top Line: Filtered Grams */
        snprintf(buf, sizeof(buf), "GRAMS: %d", (int)weight);
        draw_text(0, 10, buf);

        /* 3. Bottom Line: Raw Unfiltered ADC */
        snprintf(buf, sizeof(buf), "RAW: %d", latest_raw);
        draw_text(0, 45, buf);

        /* Tare logic: Zero out the scale if button is pressed */
        if (gpio_pin_get_dt(&btn)) {
            tare_offset = filtered_raw;
        }

        /* Blast to OLED */
        display_write(disp, 0, 0, &desc, frame_buffer);
        
        /* Yield to let other things run, refreshing screen at a smooth ~40Hz */
        k_sleep(K_MSEC(25)); 
    }
}